## Kconfig.defconfig
```kconfig
# Copyright (c) 2020 Ryan Cross
# SPDX-License-Identifier: MIT

if SHIELD_ADDY_LEFT

config ZMK_KEYBOARD_NAME
    default "addy"

config ZMK_SPLIT_ROLE_CENTRAL
    default y

endif

if SHIELD_ADDY_LEFT || SHIELD_ADDY_RIGHT

config ZMK_SPLIT
    default y

endif
```

## Kconfig.shield
```kconfig
# Copyright (c) 2020 Ryan Cross
# SPDX-License-Identifier: MIT

config SHIELD_ADDY_LEFT
    def_bool $(shields_list_contains,addy_left)

config SHIELD_ADDY_RIGHT
    def_bool $(shields_list_contains,addy_right)
```

## addy64/zmk_config/Kconfig.defconfig
```kconfig
# Copyright (c) 2020 Ryan Cross
# SPDX-License-Identifier: MIT


if SHIELD_MYKLOR_LEFT

config ZMK_KEYBOARD_NAME
    default "mukyria"

config ZMK_SPLIT_ROLE_CENTRAL
    default y

if ZMK_DISPLAY

config I2C
    default y

config SSD1306
    default y

endif

endif

if SHIELD_MYKLOR_LEFT || SHIELD_MYKLOR_RIGHT

config ZMK_SPLIT
    default y

endif
```

## addy64/zmk_config/Kconfig.shield
```kconfig
# Copyright (c) 2020 Ryan Cross
# SPDX-License-Identifier: MIT

config SHIELD_MYKLOR_LEFT
    def_bool $(shields_list_contains,MYKLOR_left)

config SHIELD_MYKLOR_RIGHT
    def_bool $(shields_list_contains,MYKLOR_right)
```

## cornia/zmk/Kconfig.shield
```kconfig
config SHIELD_CORNIA_LEFT
    def_bool $(shields_list_contains,cornia_left)

config SHIELD_CORNIA_RIGHT
    def_bool $(shields_list_contains,cornia_right)
```

## five-six/boards/shields/five-six/Kconfig.defconfig
```kconfig
if SHIELD_FIVE_SIX_LEFT

# Name must be less than 16 characters long!
config ZMK_KEYBOARD_NAME
    default "Five Six"

config ZMK_SPLIT_ROLE_CENTRAL
    default y

endif

if SHIELD_FIVE_SIX_LEFT || SHIELD_FIVE_SIX_RIGHT

config ZMK_SPLIT
    default y

endif
```

## five-six/boards/shields/five-six/Kconfig.shield
```kconfig
# No whitespace after the comma or in your part name!
config SHIELD_FIVE_SIX_LEFT
    def_bool $(shields_list_contains,five_six_left)

# No whitespace after the comma or in your part name!
config SHIELD_FIVE_SIX_RIGHT
    def_bool $(shields_list_contains,five_six_right)
```

## zmk/Kconfig.defconfig
```kconfig
# Copyright (c) 2020 Ryan Cross
# SPDX-License-Identifier: MIT


if SHIELD_ADDY_LEFT

config ZMK_KEYBOARD_NAME
    default "addy"

config ZMK_SPLIT_ROLE_CENTRAL
    default y

if ZMK_DISPLAY

config I2C
    default y

config SSD1306
    default y

endif

endif

if SHIELD_ADDY_LEFT || SHIELD_ADDY_RIGHT

config ZMK_SPLIT
    default y

endif
```
