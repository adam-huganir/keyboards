/*
 * Copyright (c) 2020 Ryan Cross
 *
 * SPDX-License-Identifier: MIT
 */

#include "addy.dtsi"

&default_transform {
    col-offset = <7>;
};


&kscan0 {
    col-gpios
        = <&gpio0 24  GPIO_ACTIVE_HIGH>      // col 0
        , <&gpio0 11  GPIO_ACTIVE_HIGH>      // col 1
        , <&gpio0 22  GPIO_ACTIVE_HIGH>      // col 2
        , <&gpio0 20  GPIO_ACTIVE_HIGH>      // col 3
        , <&gpio1 0   GPIO_ACTIVE_HIGH>      // col 4
        , <&gpio0 17  GPIO_ACTIVE_HIGH>      // col 5
        , <&gpio1 4   GPIO_ACTIVE_HIGH>      // col 6
        ;

    row-gpios
        = <&gpio1 11 (GPIO_ACTIVE_HIGH | GPIO_PULL_DOWN)>
        , <&gpio0 10 (GPIO_ACTIVE_HIGH | GPIO_PULL_DOWN)>
        , <&gpio1 13 (GPIO_ACTIVE_HIGH | GPIO_PULL_DOWN)>
        , <&gpio1 15 (GPIO_ACTIVE_HIGH | GPIO_PULL_DOWN)>
        , <&gpio0 2  (GPIO_ACTIVE_HIGH | GPIO_PULL_DOWN)>
        ;
};
